## boards/dirtyjtag/dirtyjtag_bluepill/Kconfig.dirtyjtag_bluepill
```kconfig
# SPDX-License-Identifier: Apache-2.0

config BOARD_DIRTYJTAG_BLUEPILL
	select SOC_STM32F103XB
```

## boards/dirtyjtag/dirtyjtag_bluepill/board.yml
```yaml
board:
  name: dirtyjtag_bluepill
  full_name: DirtyJTAG Bluepill
  vendor: dirtyjtag
  socs:
    - name: stm32f103xb
```

## dirty_jtag/boards/others/nodemcu_esp32s/Kconfig
```kconfig
# SPDX-License-Identifier: Apache-2.0

config HEAP_MEM_POOL_ADD_SIZE_BOARD
	int
	default 4096 if BOARD_NODEMCU_ESP32S_ESP32_PROCPU
```

## dirty_jtag/boards/others/nodemcu_esp32s/Kconfig.nodemcu_esp32s
```kconfig
# SPDX-License-Identifier: Apache-2.0

config BOARD_NODEMCU_ESP32S
	select SOC_ESP32_WROOM_32UE_N4
	select SOC_ESP32_PROCPU if BOARD_NODEMCU_ESP32S_ESP32_PROCPU
```

## dirty_jtag/boards/others/nodemcu_esp32s/board.yml
```yaml
board:
  name: nodemcu_esp32s
  full_name: NodeMCU ESP-32S
  vendor: others
  socs:
    - name: esp32
```

## dirty_jtag/boards/others/nodemcu_esp32s/nodemcu_esp32s_esp32_procpu_defconfig
```kconfig
# SPDX-License-Identifier: Apache-2.0

CONFIG_GPIO=y
CONFIG_SERIAL=y
CONFIG_UART_CONSOLE=y
CONFIG_CONSOLE=y

# Keep older ESP32-WROOM modules usable.
CONFIG_ESP32_USE_UNSUPPORTED_REVISION=y
```

## tests/native_sim/testcase.yaml
```yaml
tests:
  dirtyjtag.native_sim.universal_core:
    platform_allow:
      - native_sim/native/64
    tags:
      - dirtyjtag
      - native_sim
      - programmer
      - debugger
    integration_platforms:
      - native_sim/native/64
```
